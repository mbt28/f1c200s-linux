## package/cedar-decode-test/Config.in
```kconfig
config BR2_PACKAGE_CEDAR_DECODE_TEST
	bool "cedar-decode-test"
	depends on BR2_PACKAGE_LIBCEDARC
	help
	  Minimal standalone Allwinner Cedar (libcedarc) H.264 decode test.
	  Validates the kernel cedar/VE driver + /dev/ion + libcedarc chain
	  without ffmpeg. Run on target:  cedar-decode-test clip.h264

comment "cedar-decode-test needs libcedarc"
	depends on !BR2_PACKAGE_LIBCEDARC
```

## package/esp-hosted-ng/Config.in
```kconfig
config BR2_PACKAGE_ESP_HOSTED_NG
	bool "esp-hosted-ng"
	depends on BR2_LINUX_KERNEL
	help
	  ESP-Hosted-NG host driver: WiFi (cfg80211 fullmac, wlan0) and
	  Bluetooth (hci0) through an ESP32 co-processor running the
	  ESP-Hosted-NG firmware. On the Lctech Pi F1C200s the ESP32
	  hangs off spi1 (PE7-PE10, DT patch 0012); the module is loaded
	  on demand by `wifi on` (rootfs-overlay/usr/bin/wifi).

	  The kernel needs CONFIG_CFG80211=m and CONFIG_BT=m (board
	  fragment) and the ESP32 must run the firmware from the SAME
	  esp-hosted release as this driver pin (docs/wireless-esp-hosted.md).

	  https://github.com/espressif/esp-hosted

comment "esp-hosted-ng needs a Linux kernel to be built"
	depends on !BR2_LINUX_KERNEL
```

## package/libudev-zero/Config.in
```kconfig
config BR2_PACKAGE_LIBUDEV_ZERO
	bool "libudev-zero"
	depends on !BR2_STATIC_LIBS
	help
	  Daemonless drop-in replacement for libudev — provides the
	  libudev API (and libudev.pc) without a udev daemon, so the
	  device manager (mdev/devtmpfs) is unchanged.

	  ffmpeg's v4l2-request hwaccel uses libudev to enumerate the
	  /dev/mediaX decoder node.

	  https://github.com/illiliti/libudev-zero

comment "libudev-zero needs a toolchain w/ dynamic library"
	depends on BR2_STATIC_LIBS

# Vendored here because Buildroot <= 2026.05 predates the upstream
# libudev-zero package (added on master afterwards). Kept standalone (no
# BR2_PACKAGE_HAS_LIBUDEV virtual, which 2026.05 also lacks); ffmpeg depends
# on it directly (see scripts/build.sh). Drop this when the pinned Buildroot
# gains the package upstream.
```

## package/musb-collision-test/Config.in
```kconfig
config BR2_PACKAGE_MUSB_COLLISION_TEST
	bool "musb-collision-test"
	depends on BR2_PACKAGE_LIBUSB
	help
	  Deterministic reproducer for the suniv MUSB shared-FIFO datapath
	  collision (RX-DMA vs TX-PIO). Runs on the board (USB host) against a
	  Linux g_zero (sourcesink) gadget peer: concurrent large-aligned
	  bulk-IN (RX-DMA) + small bulk-OUT (TX-PIO), byte-checking the IN
	  buffer against a clean reference. A mismatch = the collision
	  corrupting the in-flight RX. See docs/musb-datapath-serialization-roadmap.md.

comment "musb-collision-test needs libusb"
	depends on !BR2_PACKAGE_LIBUSB
```
