## Config.in
```kconfig
source "$BR2_EXTERNAL_CARPLAY_PATH/package/libudev-zero/Config.in"
# Wired-CarPlay dependency stack (libplist comes from upstream Buildroot).
source "$BR2_EXTERNAL_CARPLAY_PATH/package/libimobiledevice-glue/Config.in"
source "$BR2_EXTERNAL_CARPLAY_PATH/package/libusbmuxd/Config.in"
source "$BR2_EXTERNAL_CARPLAY_PATH/package/libtatsu/Config.in"
source "$BR2_EXTERNAL_CARPLAY_PATH/package/libimobiledevice/Config.in"
source "$BR2_EXTERNAL_CARPLAY_PATH/package/fastcarplay/Config.in"
source "$BR2_EXTERNAL_CARPLAY_PATH/package/esp-hosted-ng/Config.in"
source "$BR2_EXTERNAL_CARPLAY_PATH/package/musb-collision-test/Config.in"
```

## board/lctech/pi-f1c200s/kernel.its
```
/dts-v1/;

/*
 * FIT image for booting from the SPI NAND's mtd1 "kernel.itb" partition.
 * Assembled by post-image-nand.sh with $HOST_DIR/bin/mkimage, which needs
 * BR2_PACKAGE_HOST_UBOOT_TOOLS_FIT_SUPPORT=y (Buildroot has no kernel-FIT
 * option of its own, so this file is hand-written on purpose).
 *
 * compression = "none" is DELIBERATE. zImage is already self-decompressing, so
 * gzipping it inside the FIT is pointless -- measured 4,750,240 -> 4,728,606
 * bytes, i.e. 0.5%, in exchange for a decompression step at boot. An earlier
 * plan claimed this would buy headroom in the 5.5 MiB partition; it does not.
 * The real numbers: the FIT lands at ~4.52 MiB against mtd1's 5.5 MiB.
 *
 * Load addresses match the SD boot path (uboot-sdcard.fragment): DRAM base is
 * 0x80000000, kernel at +0x8000, dtb at +0xC00000.
 */

/ {
	description = "Lctech Pi F1C200s -- NAND kernel + dtb";
	#address-cells = <1>;

	images {
		kernel {
			description = "Linux zImage";
			data = /incbin/("zImage");
			type = "kernel";
			arch = "arm";
			os = "linux";
			compression = "none";
			load = <0x80008000>;
			entry = <0x80008000>;
			hash-1 {
				algo = "crc32";
			};
		};

		fdt {
			description = "suniv-f1c200s-lctech-pi";
			data = /incbin/("suniv-f1c200s-lctech-pi.dtb");
			type = "flat_dt";
			arch = "arm";
			compression = "none";
			load = <0x80C00000>;
			hash-1 {
				algo = "crc32";
			};
		};
	};

	configurations {
		default = "conf";

		conf {
			description = "lctech-pi-f1c200s";
			kernel = "kernel";
			fdt = "fdt";
		};
	};
};
```

## package/cp-mux-probe/Config.in
```kconfig
config BR2_PACKAGE_CP_MUX_PROBE
	bool "cp-mux-probe"
	help
	  Standalone usbmux VERSION probe for the iPhone, with no FastCarPlay
	  involved. Claims the mux interface (ff/fe, EP 0x04 OUT / 0x85 IN) in
	  USB config 6, sends a usbmux VERSION packet and reports whether the
	  phone replies.

	  Exists to separate "the MUSB host cannot service the mux bulk-IN
	  endpoint while usb0 is up" from "the app is asking wrongly" -- every
	  measurement so far has been taken through the app and cannot tell
	  those apart. See docs/musb-mux-starvation.md.

	  Speaks usbfs directly, so it depends on nothing but libc.
```

## package/libimobiledevice-glue/Config.in
```kconfig
config BR2_PACKAGE_LIBIMOBILEDEVICE_GLUE
	bool "libimobiledevice-glue"
	select BR2_PACKAGE_LIBPLIST
	help
	  A library with common code used by the libraries and tools around
	  the libimobiledevice project.

	  https://github.com/libimobiledevice/libimobiledevice-glue
```

## package/libimobiledevice/Config.in
```kconfig
config BR2_PACKAGE_LIBIMOBILEDEVICE
	bool "libimobiledevice"
	select BR2_PACKAGE_LIBPLIST
	select BR2_PACKAGE_LIBUSBMUXD
	select BR2_PACKAGE_LIBIMOBILEDEVICE_GLUE
	select BR2_PACKAGE_LIBTATSU
	select BR2_PACKAGE_OPENSSL
	help
	  A cross-platform protocol library to communicate with Apple iOS
	  devices (lockdown, usbmux, on-device services). FastCarPlay's wired
	  CarPlay backend uses it to open com.apple.carkit.service over its own
	  cp_usbmux socket.

	  https://github.com/libimobiledevice/libimobiledevice
```

## package/libtatsu/Config.in
```kconfig
config BR2_PACKAGE_LIBTATSU
	bool "libtatsu"
	select BR2_PACKAGE_LIBPLIST
	select BR2_PACKAGE_LIBCURL
	help
	  A library to handle Apple's TSS (Tatsu Signing Server) requests.
	  Required by recent (git) libimobiledevice.

	  https://github.com/libimobiledevice/libtatsu
```

## package/libusbmuxd/Config.in
```kconfig
config BR2_PACKAGE_LIBUSBMUXD
	bool "libusbmuxd"
	select BR2_PACKAGE_LIBPLIST
	select BR2_PACKAGE_LIBIMOBILEDEVICE_GLUE
	help
	  A client library to multiplex connections from and to iOS devices
	  (the usbmux protocol). Link dependency of libimobiledevice.

	  https://github.com/libimobiledevice/libusbmuxd
```

## package/slint-cpp/Config.in
```kconfig
config BR2_PACKAGE_SLINT_CPP
	bool "slint-cpp"
	depends on BR2_PACKAGE_HOST_RUSTC_TARGET_ARCH_SUPPORTS
	depends on BR2_INSTALL_LIBSTDCPP
	depends on BR2_TOOLCHAIN_HAS_THREADS
	depends on BR2_USE_MMU
	depends on !BR2_STATIC_LIBS # fontconfig-dlopen
	depends on BR2_TOOLCHAIN_GCC_AT_LEAST_12 # C++20 consumers
	help
	  Slint GUI toolkit, C++ API. Built as a static library with
	  only the software renderer (the application owns the DRM
	  plane and hands Slint an RGB565 buffer) and with all fonts
	  and images embedded at compile time -- no fontconfig or
	  image decoders on the target.

	  Installs libslint_cpp.a plus headers into staging and the
	  hostbuilt slint-compiler into the host tools.

	  https://slint.dev

comment "slint-cpp needs a toolchain w/ C++, threads, gcc >= 12, dynamic library"
	depends on BR2_PACKAGE_HOST_RUSTC_TARGET_ARCH_SUPPORTS
	depends on BR2_USE_MMU
	depends on !BR2_INSTALL_LIBSTDCPP || !BR2_TOOLCHAIN_HAS_THREADS || \
		!BR2_TOOLCHAIN_GCC_AT_LEAST_12 || BR2_STATIC_LIBS
```
