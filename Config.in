## package/freedoom/Config.in
```kconfig
config BR2_PACKAGE_FREEDOOM
	bool "freedoom"
	depends on BR2_PACKAGE_PRBOOM
	help
	  Freedoom: free (BSD-licensed) Doom IWADs. Installs Phase 1
	  (freedoom1.wad, plays like Doom) and Phase 2 (freedoom2.wad,
	  plays like Doom II) to /usr/share/games/doom.

	  https://freedoom.github.io
```

## package/game-launcher/Config.in
```kconfig
config BR2_PACKAGE_GAME_LAUNCHER
	bool "game-launcher"
	depends on BR2_PACKAGE_SDL_FBCON
	help
	  `game NAME` launches one of the bundled SDL 1.2 games on the LCD:
	  it stops FastCarPlay (which owns the display and grabs the
	  keyboards) and starts it again afterwards if it was running,
	  runs the game at 792 MHz, and resets the VT and framebuffer
	  around it (vtreset) so a game that crashed cannot leave VT
	  switching locked for the next one.
```

## package/ostree/Config.in
```kconfig
config BR2_PACKAGE_OSTREE
	bool "ostree"
	depends on BR2_USE_MMU
	depends on BR2_USE_WCHAR # libglib2
	depends on BR2_TOOLCHAIN_HAS_THREADS # libglib2
	depends on BR2_TOOLCHAIN_USES_GLIBC # a static ostree-prepare-root
	depends on !BR2_STATIC_LIBS
	select BR2_PACKAGE_E2FSPROGS
	select BR2_PACKAGE_LIBCURL
	select BR2_PACKAGE_LIBGLIB2
	select BR2_PACKAGE_OPENSSL
	select BR2_PACKAGE_UTIL_LINUX
	select BR2_PACKAGE_UTIL_LINUX_LIBMOUNT
	select BR2_PACKAGE_XZ
	select BR2_PACKAGE_ZLIB
	help
	  OSTree, for the board's whole-system updates (docs/ostree.md).
	  Commits are signed with ed25519 through OpenSSL, with no GnuPG;
	  ostree-prepare-root is static, so that the kernel can run it as
	  init, with no initramfs. Buildroot's own libostree (2023.8) has
	  neither: this is the version LEHU OS runs.

	  https://ostreedev.github.io/ostree/

comment "ostree needs a glibc toolchain w/ threads, dynamic library, wchar"
	depends on BR2_USE_MMU
	depends on !BR2_USE_WCHAR || !BR2_TOOLCHAIN_HAS_THREADS || \
		!BR2_TOOLCHAIN_USES_GLIBC || BR2_STATIC_LIBS
```

## package/ostreefs/Config.in
```kconfig
config BR2_TARGET_ROOTFS_OSTREEFS
	bool "root filesystem as an OSTree system (rootfs.ostreefs)"
	depends on BR2_PACKAGE_OSTREE
	depends on BR2_ROOTFS_MERGED_USR # OSTree keeps the system in /usr
	help
	  The root filesystem in OSTree's layout, committed to the
	  repository <output>/ostree_repo, and an ext4 image for p2 holding
	  one deployment of that commit (docs/ostree.md).

config BR2_TARGET_ROOTFS_OSTREEFS_SIZE
	int "size of the image, in KiB"
	default 524288
	depends on BR2_TARGET_ROOTFS_OSTREEFS
```
